## conf/distro/rpi3doe.conf
```bitbake
MAINTAINER = "gsp-p-77 gero.sparwald@gmail.com"
require conf/distro/poky.conf
DISTRO = "rpi3doe"
DISTRO_NAME = "rpi3doe"
DISTRO_VERSION = "1.0"
DISTRO_CODENAME = "rpi3doe"

#DISTRO_FEATURES_remove += " sysvinit bluetooth pcmcia wayland bluez5 pci ext2 irda x11 nfc ptest 3g"
DISTRO_FEATURES:remove = " sysvinit  ptest 3g"
DISTRO_FEATURES:append = " systemd wifi dbus"
DISTRO_FEATURES:append = " virtualization"
VIRTUAL-RUNTIME_init_manager = "systemd"
VIRTUAL-RUNTIME_initscripts = "systemd-compat-units"
DISTRO_FEATURES_BACKFILL_CONSIDERED += "sysvinit"
hostname:pn-base-files = "rpi3-docker-engine"
```

## conf/layer.conf
```bitbake
# We have a conf and classes directory, add to BBPATH
BBPATH .= ":${LAYERDIR}"

# We have recipes-* directories, add to BBFILES
BBFILES += "${LAYERDIR}/recipes-*/*/*.bb \
            ${LAYERDIR}/recipes-*/*/*.bbappend"

BBFILE_COLLECTIONS += "meta-rpi3-docker-engine"
BBFILE_PATTERN_meta-rpi3-docker-engine = "^${LAYERDIR}/"
BBFILE_PRIORITY_meta-rpi3-docker-engine = "6"

LAYERDEPENDS_meta-rpi3-docker-engine = "core"
LAYERSERIES_COMPAT_meta-rpi3-docker-engine = "dunfell"
```
